// SPDX-License-Identifier: GPL-2.0-or-later OR MIT

/dts-v1/;
#include "mt7981b-tplink-wma301-v2-common.dtsi"

/ {
	model = "TP-Link WMA301 v2.0 (OpenWrt U-Boot layout)";
	compatible = "tplink,wma301-v2-ubootmod", "mediatek,mt7981";
};
