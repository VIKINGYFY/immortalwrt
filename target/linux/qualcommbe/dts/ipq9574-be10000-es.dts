// SPDX-License-Identifier: (GPL-2.0+ OR BSD-3-Clause)

#include "ipq9570-be10000.dts"

/ {
	model = "Xiaomi BE10000 ES";
	compatible = "xiaomi,be10000-es", "qcom,ipq9574";
};

&wifi1 {
	qcom,calibration-variant = "Xiaomi-BE10000-ES";
	/delete-node/ ports;
};

&wifi2 {
	qcom,calibration-variant = "Xiaomi-BE10000-ES";
	/delete-property/ qcom,wsi-controller;
	/delete-node/ ports;
};

&wifi3 {
	qcom,calibration-variant = "Xiaomi-BE10000-ES";
	/delete-node/ ports;
};
