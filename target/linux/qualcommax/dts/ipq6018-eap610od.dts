// SPDX-License-Identifier: GPL-2.0-or-later OR MIT

/dts-v1/;

#include "ipq6018-tplink-eap6xx.dtsi"

/ {
	model = "TP-Link EAP610-Outdoor";
	compatible = "tplink,eap610od", "qcom,ipq6018";
};

&wifi {
	status = "okay";
	qcom,ath11k-fw-memory-mode = <1>;
	qcom,ath11k-calibration-variant = "TP-Link-EAP610-Outdoor";
};
