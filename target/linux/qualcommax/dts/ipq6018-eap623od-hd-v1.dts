// SPDX-License-Identifier: GPL-2.0-or-later OR MIT

/dts-v1/;

#include "ipq6018-tplink-eap6xx.dtsi"

/ {
	model = "TP-Link EAP623-Outdoor HD v1";
	compatible = "tplink,eap623od-hd-v1", "qcom,ipq6018";
};

&led_sys_yellow {
		function = LED_FUNCTION_STATUS;
		gpios = <&tlmm 32 GPIO_ACTIVE_HIGH>;
};

&wifi {
	status = "okay";
	qcom,ath11k-fw-memory-mode = <1>;
	qcom,ath11k-calibration-variant = "TP-Link-EAP623-Outdoor-HD-v1";
};
