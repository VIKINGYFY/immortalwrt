// SPDX-License-Identifier: GPL-2.0-or-later OR MIT

#include "ipq8071-ax6.dts"

/ {
	model = "Redmi AX6 (stock layout)";
	compatible = "redmi,ax6-stock", "qcom,ipq8074";

	chosen {
		bootargs-append = " root=/dev/ubiblock0_1";
	};
};
