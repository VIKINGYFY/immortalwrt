// SPDX-License-Identifier: GPL-2.0-or-later OR MIT

#include "ipq8071-ax3600.dts"

/ {
	model = "Xiaomi AX3600 (stock layout)";
	compatible = "xiaomi,ax3600-stock", "qcom,ipq8074";

	chosen {
		bootargs-append = " root=/dev/ubiblock0_1";
	};
};
